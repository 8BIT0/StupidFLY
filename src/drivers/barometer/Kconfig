## src/drivers/barometer/Kconfig
```kconfig
menu "barometer"
    menuconfig COMMON_BAROMETERS
        bool "Common barometers"
        default n
        select DRIVERS_BAROMETER_BMP280
        ---help---
            Enable default set of barometer drivers
    rsource "*/Kconfig"
endmenu #barometer
```

## src/drivers/imu/Kconfig
```kconfig
menu "IMU"
    menuconfig COMMON_IMU
        bool "Common IMU's"
        default n
        select DRIVERS_IMU_BOSCH_BMI088
        select DRIVERS_IMU_INVENSENSE_ICM42688P
        ---help---
            Enable default set of IMU drivers
    rsource "*/Kconfig"
endmenu
```

## src/drivers/imu/iio/lyra/Kconfig
```kconfig
menuconfig DRIVERS_IMU_IIO_LYRA
    bool "iio_lyra"
    default n
    ---help---
        Enable support for iio_lyra

config IIO_GYRO_CONFIG_PATH
    string "IMU gyro iio device config path"
    default "/sys/bus/iio/devices/iio:device1"
    ---help---
        linux iio gyro deivce config path

config IIO_ACCEL_CONFIG_PATH
    string "IMU accel iio device config path"
    default "/sys/bus/iio/devices/iio:device2"
    ---help---
        linux iio accel deivce config path

config IIO_GYRO_DEV_PATH
    string "IMU gyro iio device data path"
    default "/dev/iio:device1"
    ---help---
        linux iio gyro buffer data path

config IIO_ACCEL_DEV_PATH
    string "IMU accel iio device data path"
    default "/dev/iio:device2"
    ---help---
        linux iio accel buffer data path
```

## src/drivers/magnetometer/Kconfig
```kconfig
menu "Magnetometer"
    menuconfig COMMON_MAGNETOMETER
        bool "Common Magnetometer's"
        default n
        select DRIVERS_MAGNETOMETER_AKM_AK8963
        select DRIVERS_MAGNETOMETER_HMC5883
        select DRIVERS_MAGNETOMETER_ISENTEK_IST8310
        ---help---
            Enable default set of magnetometer drivers
    rsource "*/Kconfig"
endmenu
```

## src/drivers/serial_dshot/Kconfig
```kconfig
menuconfig DRIVERS_SERIAL_DSHOT
	bool "serial dshot"
	default n
	---help---
		Enable support for serial transmit serial dshot output
```

## src/drivers/uavcan/Kconfig
```kconfig
menuconfig DRIVERS_UAVCAN
	bool "uavcan"
	default n
	---help---
		Enable support for uavcan

if DRIVERS_UAVCAN
    config UAVCAN_ARMING_CONTROLLER
        bool "Include arming status controller"
        default y

    config UAVCAN_BEEP_CONTROLLER
        bool "Include beep controller"
        default n

    config UAVCAN_OUTPUTS_CONTROLLER
        bool "Include servo & ESC controller"
        default y

    config UAVCAN_HARDPOINT_CONTROLLER
        bool "Include hardpoint controller"
        default n

    config UAVCAN_SAFETY_STATE_CONTROLLER
        bool "Include safety state controller"
        default n

    config UAVCAN_REMOTEID_CONTROLLER
        bool "Include remote ID controller"
        default n

    config UAVCAN_RGB_CONTROLLER
        bool "Include rgb controller"
        default n

    config UAVCAN_SENSOR_ACCEL
        bool "Subscribe to IMU:                         uavcan::equipment::ahrs::RawIMU"
        default n

    config UAVCAN_SENSOR_AIRSPEED
        bool "Subscribe to Airspeed:                    uavcan::equipment::air_data::IndicatedAirspeed | uavcan::equipment::air_data::TrueAirspeed | uavcan::equipment::air_data::StaticTemperature"
        default n

    config UAVCAN_SENSOR_BARO
        bool "Subscribe to Barometer:                   uavcan::equipment::air_data::StaticPressure | uavcan::equipment::air_data::StaticTemperature"
        default n

    config UAVCAN_SENSOR_BATTERY
        bool "Subscribe to Battery:                     uavcan::equipment::power::BatteryInfo | ardupilot::equipment::power::BatteryInfoAux | cuav::equipment::power::CBAT"
        default y

    config UAVCAN_SENSOR_DIFFERENTIAL_PRESSURE
        bool "Subscribe to Differential Pressure:       uavcan::equipment::air_data::RawAirData"
        default n

    config UAVCAN_SENSOR_FLOW
        bool "Subscribe to Flow:                        com::hex::equipment::flow::Measurement"
        default y

    config UAVCAN_SENSOR_FUEL_TANK_STATUS
        bool "Subscribe to Fuel Tank Status:            uavcan::equipment::ice::FuelTankStatus"
        default n

    config UAVCAN_SENSOR_GNSS
        bool "Subscribe to GPS:                         uavcan::equipment::gnss::Auxiliary | uavcan::equipment::gnss::Fix | uavcan::equipment::gnss::Fix2"
        default n

    config UAVCAN_SENSOR_GNSS_RELATIVE
        bool "Subscribe to GPS Relative:                ardupilot::equipment::gnss::RelPosHeading"
        default n

    config UAVCAN_SENSOR_HYGROMETER
        bool "Subscribe to Hygrometer:                  dronecan::sensors::hygrometer::Hygrometer"
        default n

    config UAVCAN_SENSOR_ICE_STATUS
        bool "Subscribe to Internal Combustion Engine:  uavcan::equipment::ice::reciprocating::Status"
        default n

    config UAVCAN_SENSOR_MAG
        bool "Subscribe to Magnetometer:                uavcan::equipment::ahrs::MagneticFieldStrength | uavcan::equipment::ahrs::MagneticFieldStrength2"
        default n

    config UAVCAN_SENSOR_RANGEFINDER
        bool "Subscribe to Rangefinder:                 uavcan::equipment::range_sensor::Measurement"
        default n

    config UAVCAN_SENSOR_SAFETY_BUTTON
        bool "Subscribe to Safety Button:               ardupilot::indication::Button"
        default n

endif #DRIVERS_UAVCAN


menuconfig BOARD_UAVCAN_INTERFACES
depends on DRIVERS_UAVCAN || DRIVERS_UAVCANNODE
    int "UAVCANv0 interface count"
    default 2
    ---help---
        Interface count for UAVCANv0

menuconfig BOARD_UAVCAN_PERIPHERALS
depends on DRIVERS_UAVCAN
    string "UAVCAN peripheral firmware"
    help
        list of UAVCAN peripheral firmware to build and embed

menuconfig BOARD_UAVCAN_TIMER_OVERRIDE
depends on DRIVERS_UAVCAN
    int "UAVCAN timer override"
    default 0
```
